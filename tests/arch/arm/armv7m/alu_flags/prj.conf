## CMakeLists.txt
```
# SPDX-License-Identifier: Apache-2.0

cmake_minimum_required(VERSION 3.20.0)
find_package(Zephyr REQUIRED HINTS $ENV{ZEPHYR_BASE})
project(armv7m_alu_flags)

add_subdirectory(${CMAKE_CURRENT_SOURCE_DIR}/../common common)

FILE(GLOB app_sources src/*.c)
target_sources(app PRIVATE ${app_sources})
```

## prj.conf
```kconfig
CONFIG_ZTEST=y
CONFIG_MAIN_STACK_SIZE=4096
CONFIG_IDLE_STACK_SIZE=512
CONFIG_TEST_EXTRA_STACK_SIZE=1024
```

## src/main.c
```c
/*
 * SPDX-License-Identifier: Apache-2.0
 * ARMv7-M torture: ALU and flags test suite entry point.
 */

#include <zephyr/ztest.h>

ZTEST_SUITE(armv7m_alu_flags, NULL, NULL, NULL, NULL, NULL);
```

## src/test_add_sub.c
```c
/*
 * SPDX-License-Identifier: Apache-2.0
 * ARMv7-M ALU torture: ADD / SUB / ADC / SBC / RSB family.
 *
 * Reference: DDI0403E
 *   ADD (imm)  A7.7.3  lines 5601-5716
 *   ADD (reg)  A7.7.4  lines 5717-5814
 *   ADC (imm)  A7.7.1  lines 5465-5520
 *   ADC (reg)  A7.7.2  lines 5521-5600
 *   SUB (imm)  A7.7.176
 *   SBC (imm/reg) A7.7.119-120
 *   RSB (imm/reg) A7.7.116-118
 *
 * APSR flags: N bit[31], Z bit[30], C bit[29], V bit[28] (lines 769-794)
 */

#include <zephyr/ztest.h>
#include <armv7m_test.h>

/* Helper: run ADDS, return result and APSR. */
static inline uint32_t adds_r_r(uint32_t a, uint32_t b, uint32_t *apsr_out)
{
	uint32_t result, apsr;

	__asm__ volatile(
		"adds %[r], %[a], %[b]\n\t"
		"mrs  %[f], apsr\n\t"
		: [r] "=&r"(result), [f] "=r"(apsr)
		: [a] "r"(a), [b] "r"(b)
		: "cc");
	*apsr_out = apsr;
	return result;
}

static inline uint32_t subs_r_r(uint32_t a, uint32_t b, uint32_t *apsr_out)
{
	uint32_t result, apsr;

	__asm__ volatile(
		"subs %[r], %[a], %[b]\n\t"
		"mrs  %[f], apsr\n\t"
		: [r] "=&r"(result), [f] "=r"(apsr)
		: [a] "r"(a), [b] "r"(b)
		: "cc");
	*apsr_out = apsr;
	return result;
}

/* ADC: result = a + b + carry_in */
static inline uint32_t adcs(uint32_t a, uint32_t b, uint32_t carry_in,
			     uint32_t *apsr_out)
{
	uint32_t result, apsr;

	__asm__ volatile(
		/* Set carry flag from carry_in */
		"lsrs %[ci], %[ci], #1\n\t" /* shift bit 0 into C */
		"adcs %[r], %[a], %[b]\n\t"
		"mrs  %[f], apsr\n\t"
		: [r] "=&r"(result), [f] "=r"(apsr), [ci] "+r"(carry_in)
		: [a] "r"(a), [b] "r"(b)
		: "cc");
	*apsr_out = apsr;
	return result;
}

/* SBC: result = a - b - NOT(carry_in) */
static inline uint32_t sbcs(uint32_t a, uint32_t b, uint32_t carry_in,
			     uint32_t *apsr_out)
{
	uint32_t result, apsr;

	__asm__ volatile(
		"lsrs %[ci], %[ci], #1\n\t"
		"sbcs %[r], %[a], %[b]\n\t"
		"mrs  %[f], apsr\n\t"
		: [r] "=&r"(result), [f] "=r"(apsr), [ci] "+r"(carry_in)
		: [a] "r"(a), [b] "r"(b)
		: "cc");
	*apsr_out = apsr;
	return result;
}

static inline uint32_t rsbs(uint32_t a, uint32_t *apsr_out)
{
	uint32_t result, apsr;

	__asm__ volatile(
		"rsbs %[r], %[a], #0\n\t"
		"mrs  %[f], apsr\n\t"
		: [r] "=&r"(result), [f] "=r"(apsr)
		: [a] "r"(a)
		: "cc");
	*apsr_out = apsr;
	return result;
}

/* --- ADDS tests -------------------------------------------------------- */

ZTEST(armv7m_alu_flags, test_adds_zero_plus_zero)
{
	uint32_t apsr;
	uint32_t r = adds_r_r(0, 0, &apsr);

	zassert_equal(r, 0, "0+0 result wrong: 0x%08x", r);
	zassert_true(armv7m_flag_z(apsr), "Z not set");
	zassert_false(armv7m_flag_n(apsr), "N spuriously set");
	zassert_false(armv7m_flag_c(apsr), "C spuriously set");
	zassert_false(armv7m_flag_v(apsr), "V spuriously set");
}

ZTEST(armv7m_alu_flags, test_adds_zero_plus_one)
{
	uint32_t apsr;
	uint32_t r = adds_r_r(0, 1, &apsr);

	zassert_equal(r, 1, "0+1 result wrong");
	zassert_false(armv7m_flag_z(apsr), "Z spuriously set");
	zassert_false(armv7m_flag_n(apsr), "N spuriously set");
	zassert_false(armv7m_flag_c(apsr), "C spuriously set");
	zassert_false(armv7m_flag_v(apsr), "V spuriously set");
}

/* MAX + 1: carry + zero, no overflow (unsigned wraps, not signed) */
ZTEST(armv7m_alu_flags, test_adds_max_plus_one_carry_zero)
{
	uint32_t apsr;
	uint32_t r = adds_r_r(0xFFFFFFFFU, 1U, &apsr);

	zassert_equal(r, 0, "0xFFFFFFFF+1 result wrong: 0x%08x", r);
	zassert_true(armv7m_flag_z(apsr), "Z not set");
	zassert_true(armv7m_flag_c(apsr), "C not set");
	zassert_false(armv7m_flag_v(apsr), "V spuriously set");
	zassert_false(armv7m_flag_n(apsr), "N spuriously set");
}

/* 0x7FFFFFFF + 1: signed overflow, not unsigned carry */
ZTEST(armv7m_alu_flags, test_adds_signed_overflow)
{
	uint32_t apsr;
	uint32_t r = adds_r_r(0x7FFFFFFFU, 1U, &apsr);

	zassert_equal(r, 0x80000000U, "overflow result wrong: 0x%08x", r);
	zassert_false(armv7m_flag_z(apsr), "Z spuriously set");
	zassert_true(armv7m_flag_n(apsr), "N not set");
	zassert_false(armv7m_flag_c(apsr), "C spuriously set");
	zassert_true(armv7m_flag_v(apsr), "V not set");
}

/* 0x80000000 + 0x80000000: both carry and overflow */
ZTEST(armv7m_alu_flags, test_adds_carry_and_overflow)
{
	uint32_t apsr;
	uint32_t r = adds_r_r(0x80000000U, 0x80000000U, &apsr);

	zassert_equal(r, 0, "0x80000000+0x80000000 result wrong");
	zassert_true(armv7m_flag_z(apsr), "Z not set");
	zassert_true(armv7m_flag_c(apsr), "C not set");
	zassert_true(armv7m_flag_v(apsr), "V not set");
}

/* Negative result: N set */
ZTEST(armv7m_alu_flags, test_adds_negative_result)
{
	uint32_t apsr;
	uint32_t r = adds_r_r(0xFFFFFFFEU, 1U, &apsr);

	zassert_equal(r, 0xFFFFFFFFU, "result wrong");
	zassert_true(armv7m_flag_n(apsr), "N not set");
	zassert_false(armv7m_flag_z(apsr), "Z spuriously set");
	zassert_false(armv7m_flag_c(apsr), "C spuriously set");
	zassert_false(armv7m_flag_v(apsr), "V spuriously set");
}

ZTEST(armv7m_alu_flags, test_adds_imm_commutative)
{
	uint32_t apsr1, apsr2;
	uint32_t r1 = adds_r_r(0x12345678U, 0x9ABCDEF0U, &apsr1);
	uint32_t r2 = adds_r_r(0x9ABCDEF0U, 0x12345678U, &apsr2);

	zassert_equal(r1, r2, "ADD not commutative");
	zassert_equal(apsr1 & ARMV7M_NZCV_MASK, apsr2 & ARMV7M_NZCV_MASK,
		      "flags differ");
}

/* --- SUBS tests -------------------------------------------------------- */

ZTEST(armv7m_alu_flags, test_subs_zero_minus_zero)
{
	uint32_t apsr;
	uint32_t r = subs_r_r(0, 0, &apsr);

	zassert_equal(r, 0, "0-0 result wrong");
	zassert_true(armv7m_flag_z(apsr), "Z not set");
	zassert_true(armv7m_flag_c(apsr), "C (borrow=0) not set");
	zassert_false(armv7m_flag_n(apsr), "N spuriously set");
	zassert_false(armv7m_flag_v(apsr), "V spuriously set");
}

ZTEST(armv7m_alu_flags, test_subs_borrow)
{
	uint32_t apsr;
	uint32_t r = subs_r_r(0, 1, &apsr);

	zassert_equal(r, 0xFFFFFFFFU, "0-1 result wrong");
	zassert_true(armv7m_flag_n(apsr), "N not set");
	zassert_false(armv7m_flag_z(apsr), "Z spuriously set");
	zassert_false(armv7m_flag_c(apsr), "C (borrow=1) spuriously set");
	zassert_false(armv7m_flag_v(apsr), "V spuriously set");
}

/* 0x80000000 - 1: signed underflow+overflow */
ZTEST(armv7m_alu_flags, test_subs_signed_underflow)
{
	uint32_t apsr;
	uint32_t r = subs_r_r(0x80000000U, 1U, &apsr);

	zassert_equal(r, 0x7FFFFFFFU, "result wrong");
	zassert_true(armv7m_flag_v(apsr), "V not set");
	zassert_true(armv7m_flag_c(apsr), "C not set");
	zassert_false(armv7m_flag_n(apsr), "N spuriously set");
}

ZTEST(armv7m_alu_flags, test_subs_equal)
{
	uint32_t apsr;
	uint32_t r = subs_r_r(0xDEADBEEFU, 0xDEADBEEFU, &apsr);

	zassert_equal(r, 0, "equal sub result wrong");
	zassert_true(armv7m_flag_z(apsr), "Z not set");
	zassert_true(armv7m_flag_c(apsr), "C not set");
}

/* --- ADC tests --------------------------------------------------------- */

ZTEST(armv7m_alu_flags, test_adcs_no_carry)
{
	uint32_t apsr;
	/* carry_in = 0 (bit 0 = 0 -- shifted into C gives C=0) */
	uint32_t r = adcs(5, 3, 0, &apsr);

	zassert_equal(r, 8, "ADC no-carry wrong");
}

ZTEST(armv7m_alu_flags, test_adcs_with_carry)
{
	uint32_t apsr;
	/* carry_in = 1 (bit 0 = 1 -- shifted gives C=1) */
	uint32_t r = adcs(5, 3, 1, &apsr);

	/* 5 + 3 + 1 = 9 */
	zassert_equal(r, 9, "ADC with carry wrong: %d", r);
}

ZTEST(armv7m_alu_flags, test_adcs_max_carry_propagate)
{
	uint32_t apsr;
	/* 0xFFFFFFFF + 0 + C=1 = 0 with carry out */
	uint32_t r = adcs(0xFFFFFFFFU, 0U, 1, &apsr);

	zassert_equal(r, 0, "ADC max+C=1 result wrong");
	zassert_true(armv7m_flag_z(apsr), "Z not set");
	zassert_true(armv7m_flag_c(apsr), "C not set");
}

/* --- SBC tests --------------------------------------------------------- */

ZTEST(armv7m_alu_flags, test_sbcs_no_borrow)
{
	uint32_t apsr;
	/* C=1 means no borrow: result = a - b */
	uint32_t r = sbcs(10, 3, 1, &apsr);

	zassert_equal(r, 7, "SBC no-borrow wrong: %d", r);
}

ZTEST(armv7m_alu_flags, test_sbcs_with_borrow)
{
	uint32_t apsr;
	/* C=0 means borrow: result = a - b - 1 */
	uint32_t r = sbcs(10, 3, 0, &apsr);

	zassert_equal(r, 6, "SBC with borrow wrong: %d", r);
}

/* --- RSB tests --------------------------------------------------------- */

ZTEST(armv7m_alu_flags, test_rsbs_zero)
{
	uint32_t apsr;
	/* RSB 0, #0 = 0 */
	uint32_t r = rsbs(0, &apsr);

	zassert_equal(r, 0, "RSB 0 wrong");
	zassert_true(armv7m_flag_z(apsr), "Z not set");
	zassert_true(armv7m_flag_c(apsr), "C not set");
}

ZTEST(armv7m_alu_flags, test_rsbs_negate)
{
	uint32_t apsr;
	/* RSB 1, #0 = -1 = 0xFFFFFFFF */
	uint32_t r = rsbs(1, &apsr);

	zassert_equal(r, 0xFFFFFFFFU, "RSB 1 wrong");
	zassert_true(armv7m_flag_n(apsr), "N not set");
	zassert_false(armv7m_flag_c(apsr), "C spuriously set");
}

/* --- ADD immediate (wide encoding T3/T4) variants --------------------- */

ZTEST(armv7m_alu_flags, test_add_imm12)
{
	uint32_t result;

	__asm__ volatile(
		"movw %[r], #0\n\t"
		"addw %[r], %[r], #0xFFF\n\t" /* ADDW: imm12, no flag update */
		: [r] "=&r"(result)
		:
		: );
	zassert_equal(result, 0xFFF, "ADDW imm12 wrong: 0x%x", result);
}

/* ADD SP + imm (A7.7.5) */
ZTEST(armv7m_alu_flags, test_add_sp_plus_imm)
{
	uint32_t sp_val, result;

	__asm__ volatile(
		"mov %[s], sp\n\t"
		"add %[r], sp, #8\n\t"
		: [s] "=&r"(sp_val), [r] "=&r"(result)
		:
		: );
	zassert_equal(result, sp_val + 8, "ADD SP+8 wrong");
}
```

## src/test_bitfield.c
```c
/*
 * SPDX-License-Identifier: Apache-2.0
 * ARMv7-M ALU: Bitfield and miscellaneous data-processing.
 *
 * Reference: DDI0403E
 *   BFC   A7.7.13  lines 6485-6534
 *   BFI   A7.7.14  lines 6535-6586
 *   SBFX  A7.7.124
 *   UBFX  A7.7.196
 *   CLZ   A7.7.24  lines 7065-7114
 *   RBIT  A7.7.112 lines 12485-12532
 *   REV   A7.7.113
 *   REV16 A7.7.114
 *   REVSH A7.7.115
 */

#include <zephyr/ztest.h>
#include <armv7m_test.h>

/* BFC: bit field clear */
ZTEST(armv7m_alu_flags, test_bfc_middle_bits)
{
	uint32_t r = 0xFFFFFFFFU;

	__asm__ volatile("bfc %[r], #8, #8\n\t" : [r] "+r"(r) : : );
	/* Clear bits [15:8]: result = 0xFFFF00FF */
	zassert_equal(r, 0xFFFF00FFU, "BFC [15:8] wrong: 0x%08x", r);
}

ZTEST(armv7m_alu_flags, test_bfc_all_bits)
{
	uint32_t r = 0xFFFFFFFFU;

	__asm__ volatile("bfc %[r], #0, #32\n\t" : [r] "+r"(r) : : );
	zassert_equal(r, 0, "BFC all 32 bits wrong");
}

ZTEST(armv7m_alu_flags, test_bfc_single_bit)
{
	uint32_t r = 0xFFFFFFFFU;

	__asm__ volatile("bfc %[r], #15, #1\n\t" : [r] "+r"(r) : : );
	zassert_equal(r, 0xFFFF7FFFU, "BFC single bit[15] wrong: 0x%08x", r);
}

/* BFI: bit field insert */
ZTEST(armv7m_alu_flags, test_bfi_insert)
{
	uint32_t dst = 0, src = 0xABU;

	__asm__ volatile("bfi %[d], %[s], #8, #8\n\t"
			 : [d] "+r"(dst)
			 : [s] "r"(src)
			 : );
	/* Insert bits[7:0] of src into dst[15:8] */
	zassert_equal(dst, 0xAB00U, "BFI insert wrong: 0x%08x", dst);
}

ZTEST(armv7m_alu_flags, test_bfi_preserve_surrounding)
{
	uint32_t dst = 0xFFFFFFFFU, src = 0x55U;

	__asm__ volatile("bfi %[d], %[s], #4, #8\n\t"
			 : [d] "+r"(dst)
			 : [s] "r"(src)
			 : );
	/* Bits [11:4] become 0x55; surrounding bits stay 1 */
	zassert_equal(dst, 0xFFFFF55FU, "BFI preserve wrong: 0x%08x", dst);
}

/* SBFX: signed bit field extract */
ZTEST(armv7m_alu_flags, test_sbfx_positive)
{
	uint32_t r;
	uint32_t src = 0x00000040U; /* bit 6 set */

	__asm__ volatile("sbfx %[r], %[s], #5, #4\n\t"
			 : [r] "=r"(r)
			 : [s] "r"(src)
			 : );
	/* Extract bits [8:5]: 0b0010 = 2, sign bit = 0 => +2 */
	zassert_equal((int32_t)r, 2, "SBFX positive wrong: %d", (int32_t)r);
}

ZTEST(armv7m_alu_flags, test_sbfx_negative)
{
	uint32_t r;
	uint32_t src = 0x00000080U; /* bit 7 set */

	__asm__ volatile("sbfx %[r], %[s], #5, #4\n\t"
			 : [r] "=r"(r)
			 : [s] "r"(src)
			 : );
	/* Extract bits [8:5]: 0b0100 = 4, but width=4 sign bit (bit3) is 0 => +4 */
	/* Actually: bits[8:5] of 0x80 = (0x80>>5)&0xF = 4, sign bit = 0 */
	zassert_equal((int32_t)r, 4, "SBFX bits [8:5] of 0x80 wrong: %d",
		      (int32_t)r);
}

ZTEST(armv7m_alu_flags, test_sbfx_sign_extension)
{
	uint32_t r;
	uint32_t src = 0x00000010U; /* bit 4 set */

	/* Extract bits [4:1] (lsb=1, width=4): value = 0b1000 = 8 */
	/* Sign bit (bit3 of extracted) = 1 => sign extend to -8 */
	__asm__ volatile("sbfx %[r], %[s], #1, #4\n\t"
			 : [r] "=r"(r)
			 : [s] "r"(src)
			 : );
	zassert_equal((int32_t)r, -8, "SBFX sign-ext wrong: %d", (int32_t)r);
}

/* UBFX: unsigned bit field extract */
ZTEST(armv7m_alu_flags, test_ubfx_extract)
{
	uint32_t r;
	uint32_t src = 0x12345678U;

	__asm__ volatile("ubfx %[r], %[s], #8, #8\n\t"
			 : [r] "=r"(r)
			 : [s] "r"(src)
			 : );
	/* Extract bits[15:8]: 0x56 */
	zassert_equal(r, 0x56U, "UBFX bits[15:8] wrong: 0x%02x", r);
}

ZTEST(armv7m_alu_flags, test_ubfx_no_sign_extend)
{
	uint32_t r;
	/* src = 0x0FF0: bits[11:4] = 0b1111_1111 = 0xFF
	 * UBFX #4, #8: extract bits[4+8-1:4] = bits[11:4]
	 * Result = (0x0FF0 >> 4) & 0xFF = 0xFF, no sign extension */
	__asm__ volatile("ubfx %[r], %[s], #4, #8\n\t"
			 : [r] "=r"(r)
			 : [s] "r"(0x0FF0U)
			 : );
	zassert_equal(r, 0xFFU, "UBFX no-sign wrong: 0x%x", r);
}

/* CLZ: count leading zeros */
ZTEST(armv7m_alu_flags, test_clz_zero)
{
	uint32_t r;

	__asm__ volatile("clz %[r], %[v]\n\t"
			 : [r] "=r"(r)
			 : [v] "r"(0U)
			 : );
	zassert_equal(r, 32, "CLZ 0 wrong");
}

ZTEST(armv7m_alu_flags, test_clz_all_ones)
{
	uint32_t r;

	__asm__ volatile("clz %[r], %[v]\n\t"
			 : [r] "=r"(r)
			 : [v] "r"(0xFFFFFFFFU)
			 : );
	zassert_equal(r, 0, "CLZ 0xFFFFFFFF wrong");
}

ZTEST(armv7m_alu_flags, test_clz_bit31)
{
	uint32_t r;

	__asm__ volatile("clz %[r], %[v]\n\t"
			 : [r] "=r"(r)
			 : [v] "r"(0x80000000U)
			 : );
	zassert_equal(r, 0, "CLZ bit31 wrong");
}

ZTEST(armv7m_alu_flags, test_clz_bit0)
{
	uint32_t r;

	__asm__ volatile("clz %[r], %[v]\n\t"
			 : [r] "=r"(r)
			 : [v] "r"(1U)
			 : );
	zassert_equal(r, 31, "CLZ bit0 wrong");
}

ZTEST(armv7m_alu_flags, test_clz_various)
{
	uint32_t r;

	__asm__ volatile("clz %[r], %[v]\n\t"
			 : [r] "=r"(r)
			 : [v] "r"(0x00001000U)
			 : );
	zassert_equal(r, 19, "CLZ 0x1000 wrong");
}

/* RBIT: reverse bits */
ZTEST(armv7m_alu_flags, test_rbit_bit0_to_bit31)
{
	uint32_t r;

	__asm__ volatile("rbit %[r], %[v]\n\t"
			 : [r] "=r"(r)
			 : [v] "r"(1U)
			 : );
	zassert_equal(r, 0x80000000U, "RBIT bit0->bit31 wrong");
}

ZTEST(armv7m_alu_flags, test_rbit_roundtrip)
{
	uint32_t r1, r2;
	uint32_t val = 0x12345678U;

	__asm__ volatile(
		"rbit %[r1], %[v]\n\t"
		"rbit %[r2], %[r1]\n\t"
		: [r1] "=&r"(r1), [r2] "=&r"(r2)
		: [v] "r"(val)
		: );
	zassert_equal(r2, val, "RBIT roundtrip wrong");
}

ZTEST(armv7m_alu_flags, test_rbit_palindrome)
{
	uint32_t r;

	__asm__ volatile("rbit %[r], %[v]\n\t"
			 : [r] "=r"(r)
			 : [v] "r"(0xA5A5A5A5U)
			 : );
	/* 0xA5A5A5A5 reversed bit-by-bit = 0xA5A5A5A5 */
	zassert_equal(r, 0xA5A5A5A5U, "RBIT palindrome wrong: 0x%08x", r);
}

/* REV: byte-reverse word */
ZTEST(armv7m_alu_flags, test_rev_word)
{
	uint32_t r;

	__asm__ volatile("rev %[r], %[v]\n\t"
			 : [r] "=r"(r)
			 : [v] "r"(0x12345678U)
			 : );
	zassert_equal(r, 0x78563412U, "REV word wrong: 0x%08x", r);
}

/* REV16: byte-reverse each halfword */
ZTEST(armv7m_alu_flags, test_rev16_halfwords)
{
	uint32_t r;

	__asm__ volatile("rev16 %[r], %[v]\n\t"
			 : [r] "=r"(r)
			 : [v] "r"(0x12345678U)
			 : );
	/* High half: 0x1234 -> 0x3412; low half: 0x5678 -> 0x7856 */
	zassert_equal(r, 0x34127856U, "REV16 wrong: 0x%08x", r);
}

/* REVSH: byte-reverse signed halfword.
 * Algorithm: result = SignExtend(Rm[7:0] : Rm[15:8], 32)
 * i.e., swap bytes of the bottom halfword, then sign-extend from bit15.
 */
ZTEST(armv7m_alu_flags, test_revsh_sign_extend)
{
	uint32_t r;

	/* Input 0x00000080: Rm[7:0]=0x80, Rm[15:8]=0x00
	 * Reversed halfword: 0x8000, bit15=1 => sign-ext => 0xFFFF8000 */
	__asm__ volatile("revsh %[r], %[v]\n\t"
			 : [r] "=r"(r)
			 : [v] "r"(0x00000080U)
			 : );
	zassert_equal(r, 0xFFFF8000U, "REVSH sign-extend wrong: 0x%08x", r);
}

ZTEST(armv7m_alu_flags, test_revsh_positive)
{
	uint32_t r;

	/* Input 0x00001234: Rm[7:0]=0x34, Rm[15:8]=0x12
	 * Reversed halfword: 0x3412, bit15=0 => no sign ext */
	__asm__ volatile("revsh %[r], %[v]\n\t"
			 : [r] "=r"(r)
			 : [v] "r"(0x00001234U)
			 : );
	zassert_equal(r, 0x00003412U, "REVSH positive wrong: 0x%08x", r);
}
```

## src/test_compare.c
```c
/*
 * SPDX-License-Identifier: Apache-2.0
 * ARMv7-M ALU: Compare instructions CMP / CMN / TST / TEQ.
 *
 * Reference: DDI0403E
 *   CMP A7.7.27-28  lines 7229-7372
 *   CMN A7.7.25-26  lines 7115-7228
 *   TST A7.7.193
 *   TEQ A7.7.186
 *
 * Compare instructions always update N/Z/C/V; they do not write a result.
 */

#include <zephyr/ztest.h>
#include <armv7m_test.h>

/* ---- CMP -------------------------------------------------------------- */

ZTEST(armv7m_alu_flags, test_cmp_equal)
{
	uint32_t apsr;
	uint32_t a = 0x12345678U;

	__asm__ volatile(
		"cmp %[a], %[a]\n\t"
		"mrs %[f], apsr\n\t"
		: [f] "=r"(apsr)
		: [a] "r"(a)
		: "cc");
	zassert_true(armv7m_flag_z(apsr), "Z not set for equal CMP");
	zassert_true(armv7m_flag_c(apsr), "C not set for equal CMP");
	zassert_false(armv7m_flag_n(apsr), "N spuriously set");
	zassert_false(armv7m_flag_v(apsr), "V spuriously set");
}

ZTEST(armv7m_alu_flags, test_cmp_less_unsigned)
{
	uint32_t apsr;

	__asm__ volatile(
		"cmp %[a], %[b]\n\t"
		"mrs %[f], apsr\n\t"
		: [f] "=r"(apsr)
		: [a] "r"(3U), [b] "r"(5U)
		: "cc");
	/* 3 < 5 unsigned: C=0 (borrow), N=1 */
	zassert_false(armv7m_flag_c(apsr), "C spuriously set for 3<5");
	zassert_false(armv7m_flag_z(apsr), "Z spuriously set");
	zassert_true(armv7m_flag_n(apsr), "N not set for 3<5");
}

ZTEST(armv7m_alu_flags, test_cmp_greater_unsigned)
{
	uint32_t apsr;

	__asm__ volatile(
		"cmp %[a], %[b]\n\t"
		"mrs %[f], apsr\n\t"
		: [f] "=r"(apsr)
		: [a] "r"(10U), [b] "r"(5U)
		: "cc");
	/* 10 > 5: C=1, N=0 */
	zassert_true(armv7m_flag_c(apsr), "C not set for 10>5");
	zassert_false(armv7m_flag_n(apsr), "N spuriously set");
	zassert_false(armv7m_flag_z(apsr), "Z spuriously set");
}

ZTEST(armv7m_alu_flags, test_cmp_signed_overflow)
{
	uint32_t apsr;

	/* 0x80000000 - 1 = 0x7FFFFFFF: signed overflow */
	__asm__ volatile(
		"cmp %[a], %[b]\n\t"
		"mrs %[f], apsr\n\t"
		: [f] "=r"(apsr)
		: [a] "r"(0x80000000U), [b] "r"(1U)
		: "cc");
	zassert_true(armv7m_flag_v(apsr), "V not set for signed overflow");
	zassert_true(armv7m_flag_c(apsr), "C not set");
}

ZTEST(armv7m_alu_flags, test_cmp_zero_minus_one)
{
	uint32_t apsr;

	__asm__ volatile(
		"cmp %[a], %[b]\n\t"
		"mrs %[f], apsr\n\t"
		: [f] "=r"(apsr)
		: [a] "r"(0U), [b] "r"(1U)
		: "cc");
	zassert_false(armv7m_flag_c(apsr), "C should be 0 (borrow)");
	zassert_true(armv7m_flag_n(apsr), "N not set");
}

/* CMP with immediate */
ZTEST(armv7m_alu_flags, test_cmp_imm_equal)
{
	uint32_t apsr;
	uint32_t a = 42;

	__asm__ volatile(
		"cmp %[a], #42\n\t"
		"mrs %[f], apsr\n\t"
		: [f] "=r"(apsr)
		: [a] "r"(a)
		: "cc");
	zassert_true(armv7m_flag_z(apsr), "Z not set");
}

/* ---- CMN -------------------------------------------------------------- */

ZTEST(armv7m_alu_flags, test_cmn_zero_plus_zero)
{
	uint32_t apsr;

	__asm__ volatile(
		"cmn %[a], #0\n\t"
		"mrs %[f], apsr\n\t"
		: [f] "=r"(apsr)
		: [a] "r"(0U)
		: "cc");
	zassert_true(armv7m_flag_z(apsr), "Z not set for CMN 0+0");
}

ZTEST(armv7m_alu_flags, test_cmn_overflow)
{
	uint32_t apsr;

	/* CMN 0x7FFFFFFF, 1: same as ADDS 0x7FFFFFFF + 1, V must be set */
	__asm__ volatile(
		"cmn %[a], %[b]\n\t"
		"mrs %[f], apsr\n\t"
		: [f] "=r"(apsr)
		: [a] "r"(0x7FFFFFFFU), [b] "r"(1U)
		: "cc");
	zassert_true(armv7m_flag_v(apsr), "V not set");
	zassert_false(armv7m_flag_c(apsr), "C spuriously set");
	zassert_true(armv7m_flag_n(apsr), "N not set");
}

/* ---- TST -------------------------------------------------------------- */

ZTEST(armv7m_alu_flags, test_tst_bit_set)
{
	uint32_t apsr;
	uint32_t a = 0x00000010U;

	__asm__ volatile(
		"tst %[a], #0x10\n\t"
		"mrs %[f], apsr\n\t"
		: [f] "=r"(apsr)
		: [a] "r"(a)
		: "cc");
	zassert_false(armv7m_flag_z(apsr), "Z spuriously set (bit is set)");
}

ZTEST(armv7m_alu_flags, test_tst_bit_clear)
{
	uint32_t apsr;
	uint32_t a = 0x00000010U;

	__asm__ volatile(
		"tst %[a], #0x20\n\t"
		"mrs %[f], apsr\n\t"
		: [f] "=r"(apsr)
		: [a] "r"(a)
		: "cc");
	zassert_true(armv7m_flag_z(apsr), "Z not set (bit is clear)");
}

ZTEST(armv7m_alu_flags, test_tst_high_bit)
{
	uint32_t apsr;
	uint32_t a = 0x80000001U;

	__asm__ volatile(
		"tst %[a], %[b]\n\t"
		"mrs %[f], apsr\n\t"
		: [f] "=r"(apsr)
		: [a] "r"(a), [b] "r"(0x80000000U)
		: "cc");
	zassert_true(armv7m_flag_n(apsr), "N not set for bit31");
	zassert_false(armv7m_flag_z(apsr), "Z spuriously set");
}

/* ---- TEQ -------------------------------------------------------------- */

ZTEST(armv7m_alu_flags, test_teq_equal)
{
	uint32_t apsr;
	uint32_t a = 0xCAFEBABEU;

	__asm__ volatile(
		"teq %[a], %[a]\n\t"
		"mrs %[f], apsr\n\t"
		: [f] "=r"(apsr)
		: [a] "r"(a)
		: "cc");
	zassert_true(armv7m_flag_z(apsr), "Z not set for equal TEQ");
}

ZTEST(armv7m_alu_flags, test_teq_different)
{
	uint32_t apsr;

	__asm__ volatile(
		"teq %[a], %[b]\n\t"
		"mrs %[f], apsr\n\t"
		: [f] "=r"(apsr)
		: [a] "r"(0xAAAAAAAAU), [b] "r"(0x55555555U)
		: "cc");
	zassert_false(armv7m_flag_z(apsr), "Z spuriously set");
	zassert_true(armv7m_flag_n(apsr), "N not set");
}
```

## src/test_condition.c
```c
/*
 * SPDX-License-Identifier: Apache-2.0
 * ARMv7-M: Condition codes and IT block semantics.
 *
 * Reference: DDI0403E
 *   IT block  A7.7.38  lines 7776-7870
 *   Condition codes A7.3 lines 5204-5311
 *
 * All 15 conditions (EQ NE CS CC MI PL VS VC HI LS GE LT GT LE) are
 * tested by crafting appropriate N/Z/C/V values via MOVS and CMP, then
 * using a conditional MOV inside an IT block to verify execution.
 *
 * Pattern: set up flags -> IT<cond> -> MOVcc to sentinel -> check sentinel.
 */

#include <zephyr/ztest.h>
#include <armv7m_test.h>

/* Helper: execute conditional instruction inside IT block.
 * Returns 1 if the conditional executed, 0 if it was skipped. */

/* EQ: Z=1 */
ZTEST(armv7m_alu_flags, test_cond_eq_taken)
{
	uint32_t sentinel = 0;
	uint32_t val = 5;

	__asm__ volatile(
		"cmp  %[v], %[v]\n\t"    /* sets Z=1 */
		"ite  eq\n\t"
		"moveq %[s], #1\n\t"
		"movne %[s], #0\n\t"
		: [s] "+r"(sentinel)
		: [v] "r"(val)
		: "cc");
	zassert_equal(sentinel, 1, "EQ not taken");
}

ZTEST(armv7m_alu_flags, test_cond_ne_taken)
{
	uint32_t sentinel = 0;

	__asm__ volatile(
		"cmp  %[a], %[b]\n\t"    /* 1 != 2, Z=0 */
		"ite  ne\n\t"
		"movne %[s], #1\n\t"
		"moveq %[s], #0\n\t"
		: [s] "+r"(sentinel)
		: [a] "r"(1U), [b] "r"(2U)
		: "cc");
	zassert_equal(sentinel, 1, "NE not taken");
}

/* CS/HS: C=1 */
ZTEST(armv7m_alu_flags, test_cond_cs_taken)
{
	uint32_t sentinel = 0;

	__asm__ volatile(
		"movs %[s], #0xFF\n\t"
		"adds %[s], %[s], #1\n\t"  /* 0xFF+1=0x100 in 8-bit; in 32-bit no C */
		/* use 0xFFFFFFFF + 1 for C=1 */
		"mvn  %[s], #0\n\t"        /* r = 0xFFFFFFFF */
		"adds %[s], %[s], #1\n\t"  /* C=1 */
		"ite  cs\n\t"
		"movcs %[s], #1\n\t"
		"movcc %[s], #0\n\t"
		: [s] "+r"(sentinel)
		:
		: "cc");
	zassert_equal(sentinel, 1, "CS not taken");
}

/* CC/LO: C=0 */
ZTEST(armv7m_alu_flags, test_cond_cc_taken)
{
	uint32_t sentinel = 0;

	__asm__ volatile(
		"cmp  %[a], %[b]\n\t"    /* 1 < 2 unsigned: C=0 */
		"ite  cc\n\t"
		"movcc %[s], #1\n\t"
		"movcs %[s], #0\n\t"
		: [s] "+r"(sentinel)
		: [a] "r"(1U), [b] "r"(2U)
		: "cc");
	zassert_equal(sentinel, 1, "CC not taken");
}

/* MI: N=1 */
ZTEST(armv7m_alu_flags, test_cond_mi_taken)
{
	uint32_t sentinel = 0;

	__asm__ volatile(
		"movs %[s], #0\n\t"
		"subs %[s], %[s], #1\n\t"  /* -1: N=1 */
		"ite  mi\n\t"
		"movmi %[s], #1\n\t"
		"movpl %[s], #0\n\t"
		: [s] "+r"(sentinel)
		:
		: "cc");
	zassert_equal(sentinel, 1, "MI not taken");
}

/* PL: N=0 */
ZTEST(armv7m_alu_flags, test_cond_pl_taken)
{
	uint32_t sentinel = 0;

	__asm__ volatile(
		"movs %[s], #1\n\t"        /* N=0 */
		"ite  pl\n\t"
		"movpl %[s], #1\n\t"
		"movmi %[s], #0\n\t"
		: [s] "+r"(sentinel)
		:
		: "cc");
	zassert_equal(sentinel, 1, "PL not taken");
}

/* VS: V=1 */
ZTEST(armv7m_alu_flags, test_cond_vs_taken)
{
	uint32_t sentinel = 0;

	__asm__ volatile(
		"movw %[s], #0\n\t"
		"movt %[s], #0x7FFF\n\t"   /* 0x7FFF0000 */
		"adds %[s], %[s], %[s]\n\t" /* 0x7FFF0000 * 2 = signed overflow V=1 */
		/* Use simpler: 0x7FFFFFFF + 1 -> V=1 */
		"movw %[s], #0xFFFF\n\t"
		"movt %[s], #0x7FFF\n\t"   /* 0x7FFFFFFF */
		"adds %[s], %[s], #1\n\t"  /* V=1 */
		"ite  vs\n\t"
		"movvs %[s], #1\n\t"
		"movvc %[s], #0\n\t"
		: [s] "+r"(sentinel)
		:
		: "cc");
	zassert_equal(sentinel, 1, "VS not taken");
}

/* VC: V=0 */
ZTEST(armv7m_alu_flags, test_cond_vc_taken)
{
	uint32_t sentinel = 0;

	__asm__ volatile(
		"movs %[s], #1\n\t"        /* V=0 (no overflow) */
		"ite  vc\n\t"
		"movvc %[s], #1\n\t"
		"movvs %[s], #0\n\t"
		: [s] "+r"(sentinel)
		:
		: "cc");
	zassert_equal(sentinel, 1, "VC not taken");
}

/* HI: C=1 and Z=0 (unsigned higher) */
ZTEST(armv7m_alu_flags, test_cond_hi_taken)
{
	uint32_t sentinel = 0;

	__asm__ volatile(
		"cmp  %[a], %[b]\n\t"    /* 10 > 5: C=1, Z=0 */
		"ite  hi\n\t"
		"movhi %[s], #1\n\t"
		"movls %[s], #0\n\t"
		: [s] "+r"(sentinel)
		: [a] "r"(10U), [b] "r"(5U)
		: "cc");
	zassert_equal(sentinel, 1, "HI not taken");
}

/* LS: C=0 or Z=1 (unsigned lower or same) */
ZTEST(armv7m_alu_flags, test_cond_ls_taken)
{
	uint32_t sentinel = 0;

	__asm__ volatile(
		"cmp  %[a], %[b]\n\t"    /* 3 < 10: C=0, Z=0 => LS */
		"ite  ls\n\t"
		"movls %[s], #1\n\t"
		"movhi %[s], #0\n\t"
		: [s] "+r"(sentinel)
		: [a] "r"(3U), [b] "r"(10U)
		: "cc");
	zassert_equal(sentinel, 1, "LS not taken");
}

/* GE: N=V */
ZTEST(armv7m_alu_flags, test_cond_ge_taken)
{
	uint32_t sentinel = 0;

	__asm__ volatile(
		"cmp  %[a], %[b]\n\t"    /* 5 >= 3 signed: N=0,V=0 => GE */
		"ite  ge\n\t"
		"movge %[s], #1\n\t"
		"movlt %[s], #0\n\t"
		: [s] "+r"(sentinel)
		: [a] "r"(5), [b] "r"(3)
		: "cc");
	zassert_equal(sentinel, 1, "GE not taken");
}

/* LT: N!=V */
ZTEST(armv7m_alu_flags, test_cond_lt_taken)
{
	uint32_t sentinel = 0;

	__asm__ volatile(
		"cmp  %[a], %[b]\n\t"    /* -1 < 0: N=1, V=0 => LT */
		"ite  lt\n\t"
		"movlt %[s], #1\n\t"
		"movge %[s], #0\n\t"
		: [s] "+r"(sentinel)
		: [a] "r"(-1), [b] "r"(0)
		: "cc");
	zassert_equal(sentinel, 1, "LT not taken");
}

/* GT: Z=0 and N=V */
ZTEST(armv7m_alu_flags, test_cond_gt_taken)
{
	uint32_t sentinel = 0;

	__asm__ volatile(
		"cmp  %[a], %[b]\n\t"    /* 5 > 3: Z=0, N=0, V=0 => GT */
		"ite  gt\n\t"
		"movgt %[s], #1\n\t"
		"movle %[s], #0\n\t"
		: [s] "+r"(sentinel)
		: [a] "r"(5), [b] "r"(3)
		: "cc");
	zassert_equal(sentinel, 1, "GT not taken");
}

/* LE: Z=1 or N!=V */
ZTEST(armv7m_alu_flags, test_cond_le_taken)
{
	uint32_t sentinel = 0;

	__asm__ volatile(
		"cmp  %[a], %[b]\n\t"    /* 3 <= 5: N=1, V=0 => LE (N!=V) */
		"ite  le\n\t"
		"movle %[s], #1\n\t"
		"movgt %[s], #0\n\t"
		: [s] "+r"(sentinel)
		: [a] "r"(3), [b] "r"(5)
		: "cc");
	zassert_equal(sentinel, 1, "LE not taken");
}

/* IT block with 4 instructions (ITTTT) */
ZTEST(armv7m_alu_flags, test_it_block_4_then)
{
	uint32_t a = 0, b = 0, c = 0, d = 0;

	__asm__ volatile(
		"movs %[x], #0\n\t"   /* Z=1 */
		"itttt eq\n\t"
		"moveq %[a], #1\n\t"
		"moveq %[b], #2\n\t"
		"moveq %[c], #3\n\t"
		"moveq %[d], #4\n\t"
		: [a] "+r"(a), [b] "+r"(b), [c] "+r"(c), [d] "+r"(d),
		  [x] "=&r"((uint32_t){0})
		:
		: "cc");
	zassert_equal(a, 1, "ITTTT a wrong");
	zassert_equal(b, 2, "ITTTT b wrong");
	zassert_equal(c, 3, "ITTTT c wrong");
	zassert_equal(d, 4, "ITTTT d wrong");
}

/* IT block: else branch taken */
ZTEST(armv7m_alu_flags, test_it_block_ite_else)
{
	uint32_t r = 99;

	__asm__ volatile(
		"cmp  %[a], %[b]\n\t"  /* 1 != 2, NE=true, EQ=false */
		"ite  eq\n\t"
		"moveq %[r], #0\n\t"   /* not taken */
		"movne %[r], #1\n\t"   /* taken */
		: [r] "+r"(r)
		: [a] "r"(1U), [b] "r"(2U)
		: "cc");
	zassert_equal(r, 1, "ITE else branch wrong");
}

/* Verify that a skipped instruction does not modify destination */
ZTEST(armv7m_alu_flags, test_it_skip_preserves_reg)
{
	uint32_t r = 0xDEADBEEFU;

	__asm__ volatile(
		"cmp  %[a], %[b]\n\t"  /* 1 != 2, Z=0 */
		"it   eq\n\t"
		"moveq %[r], #0\n\t"   /* should be skipped */
		: [r] "+r"(r)
		: [a] "r"(1U), [b] "r"(2U)
		: "cc");
	zassert_equal(r, 0xDEADBEEFU, "IT skip did not preserve register");
}
```

## src/test_logic.c
```c
/*
 * SPDX-License-Identifier: Apache-2.0
 * ARMv7-M ALU: Logic instructions AND / ORR / EOR / BIC / ORN / MVN.
 *
 * Reference: DDI0403E
 *   AND A7.7.8-9  lines 6111-6246
 *   ORR A7.7.91-92 lines 11205-11342
 *   EOR A7.7.35-36 lines 7592-7727
 *   BIC A7.7.15-16 lines 6587-6720
 *   ORN A7.7.89-90 lines 11089-11204
 *   MVN A7.7.85-86 lines 10903-11028
 *
 * Logic ops update N and Z from result.  C is updated from barrel
 * shifter carry-out when a shifted register operand is used; V is unchanged.
 */

#include <zephyr/ztest.h>
#include <armv7m_test.h>

/* AND */
ZTEST(armv7m_alu_flags, test_ands_all_ones)
{
	uint32_t r, apsr;

	__asm__ volatile(
		"movs %[r], #0xFF\n\t"
		"ands %[r], %[r], #0xFF\n\t"
		"mrs  %[f], apsr\n\t"
		: [r] "=&r"(r), [f] "=r"(apsr)
		:
		: "cc");
	zassert_equal(r, 0xFF, "AND all-ones wrong");
	zassert_false(armv7m_flag_z(apsr), "Z spuriously set");
	zassert_false(armv7m_flag_n(apsr), "N spuriously set");
}

ZTEST(armv7m_alu_flags, test_ands_zero_result)
{
	uint32_t r, apsr;

	__asm__ volatile(
		"movs %[r], #0xAA\n\t"
		"ands %[r], %[r], #0x55\n\t"
		"mrs  %[f], apsr\n\t"
		: [r] "=&r"(r), [f] "=r"(apsr)
		:
		: "cc");
	zassert_equal(r, 0, "AND zero result wrong");
	zassert_true(armv7m_flag_z(apsr), "Z not set");
}

ZTEST(armv7m_alu_flags, test_ands_negative_result)
{
	uint32_t a = 0xFF000000U, b = 0x80000000U, r, apsr;

	__asm__ volatile(
		"ands %[r], %[a], %[b]\n\t"
		"mrs  %[f], apsr\n\t"
		: [r] "=&r"(r), [f] "=r"(apsr)
		: [a] "r"(a), [b] "r"(b)
		: "cc");
	zassert_equal(r, 0x80000000U, "AND result wrong");
	zassert_true(armv7m_flag_n(apsr), "N not set");
}

/* ORR */
ZTEST(armv7m_alu_flags, test_orrs_combine)
{
	uint32_t r, apsr;

	__asm__ volatile(
		"mov  %[r], #0xAA\n\t"
		"orrs %[r], %[r], #0x55\n\t"
		"mrs  %[f], apsr\n\t"
		: [r] "=&r"(r), [f] "=r"(apsr)
		:
		: "cc");
	zassert_equal(r, 0xFF, "ORR combine wrong");
	zassert_false(armv7m_flag_z(apsr), "Z spuriously set");
}

ZTEST(armv7m_alu_flags, test_orrs_zero_stays_zero)
{
	uint32_t r, apsr;

	__asm__ volatile(
		"movs %[r], #0\n\t"
		"orrs %[r], %[r], #0\n\t"
		"mrs  %[f], apsr\n\t"
		: [r] "=&r"(r), [f] "=r"(apsr)
		:
		: "cc");
	zassert_equal(r, 0, "ORR zero wrong");
	zassert_true(armv7m_flag_z(apsr), "Z not set");
}

/* EOR */
ZTEST(armv7m_alu_flags, test_eors_toggle)
{
	uint32_t r, apsr;

	__asm__ volatile(
		"mov  %[r], #0xFF\n\t"
		"eors %[r], %[r], #0x0F\n\t"
		"mrs  %[f], apsr\n\t"
		: [r] "=&r"(r), [f] "=r"(apsr)
		:
		: "cc");
	zassert_equal(r, 0xF0, "EOR toggle wrong");
}

ZTEST(armv7m_alu_flags, test_eors_self_cancel)
{
	uint32_t a = 0xDEADBEEFU, r, apsr;

	__asm__ volatile(
		"eors %[r], %[a], %[a]\n\t"
		"mrs  %[f], apsr\n\t"
		: [r] "=&r"(r), [f] "=r"(apsr)
		: [a] "r"(a)
		: "cc");
	zassert_equal(r, 0, "EOR self-cancel wrong");
	zassert_true(armv7m_flag_z(apsr), "Z not set");
}

/* BIC */
ZTEST(armv7m_alu_flags, test_bics_clear_bits)
{
	uint32_t r, apsr;

	__asm__ volatile(
		"mov  %[r], #0xFF\n\t"
		"bics %[r], %[r], #0x0F\n\t"
		"mrs  %[f], apsr\n\t"
		: [r] "=&r"(r), [f] "=r"(apsr)
		:
		: "cc");
	zassert_equal(r, 0xF0, "BIC clear bits wrong");
}

ZTEST(armv7m_alu_flags, test_bics_clear_all)
{
	uint32_t a = 0xFFFFFFFFU, r, apsr;

	__asm__ volatile(
		"mvn  %[r], #0\n\t"          /* r = 0xFFFFFFFF */
		"bics %[r], %[a], %[r]\n\t"
		"mrs  %[f], apsr\n\t"
		: [r] "=&r"(r), [f] "=r"(apsr)
		: [a] "r"(a)
		: "cc");
	zassert_equal(r, 0, "BIC clear all wrong");
	zassert_true(armv7m_flag_z(apsr), "Z not set");
}

/* ORN (Thumb-2 only, no 16-bit encoding) */
ZTEST(armv7m_alu_flags, test_orns_complement_mask)
{
	uint32_t r, mask;

	/* 0xFFFF0000 is not a valid Thumb-2 modified immediate; use a register */
	__asm__ volatile(
		"movw %[m], #0\n\t"
		"movt %[m], #0xFFFF\n\t"  /* m = 0xFFFF0000 */
		"movs %[r], #0\n\t"
		"orn  %[r], %[r], %[m]\n\t"
		: [r] "=&r"(r), [m] "=&r"(mask)
		:
		: "cc");
	/* 0 ORN 0xFFFF0000 = 0 OR NOT(0xFFFF0000) = 0 OR 0x0000FFFF = 0x0000FFFF */
	zassert_equal(r, 0x0000FFFFU, "ORN wrong: 0x%08x", r);
}

/* MVN */
ZTEST(armv7m_alu_flags, test_mvns_invert)
{
	uint32_t r, apsr;

	__asm__ volatile(
		"mvns %[r], #0\n\t"
		"mrs  %[f], apsr\n\t"
		: [r] "=&r"(r), [f] "=r"(apsr)
		:
		: "cc");
	zassert_equal(r, 0xFFFFFFFFU, "MVN ~0 wrong");
	zassert_true(armv7m_flag_n(apsr), "N not set");
	zassert_false(armv7m_flag_z(apsr), "Z spuriously set");
}

ZTEST(armv7m_alu_flags, test_mvns_invert_ff)
{
	uint32_t a = 0xFFFFFFFFU, r, apsr;

	__asm__ volatile(
		"mvns %[r], %[a]\n\t"
		"mrs  %[f], apsr\n\t"
		: [r] "=&r"(r), [f] "=r"(apsr)
		: [a] "r"(a)
		: "cc");
	zassert_equal(r, 0, "MVN 0xFFFFFFFF wrong");
	zassert_true(armv7m_flag_z(apsr), "Z not set");
}

/* Logic with shifted register operand: carry from shifter */
ZTEST(armv7m_alu_flags, test_ands_shift_carry)
{
	uint32_t r, apsr;
	uint32_t a = 0x80000000U;

	/* LSL by 1 shifts a bit into carry */
	__asm__ volatile(
		"ands %[r], %[a], %[a], lsl #1\n\t"
		"mrs  %[f], apsr\n\t"
		: [r] "=&r"(r), [f] "=r"(apsr)
		: [a] "r"(a)
		: "cc");
	/* 0x80000000 LSL 1 = 0 (C=1), AND 0x80000000 = 0 */
	zassert_equal(r, 0, "AND+shift result wrong");
	zassert_true(armv7m_flag_c(apsr), "C (shifter carry) not set");
	zassert_true(armv7m_flag_z(apsr), "Z not set");
}
```

## src/test_move.c
```c
/*
 * SPDX-License-Identifier: Apache-2.0
 * ARMv7-M ALU: MOV / MOVT / ADR / MOVW.
 *
 * Reference: DDI0403E
 *   MOV (imm)     A7.7.76  lines 10358-10443
 *   MOV (reg)     A7.7.77  lines 10444-10544
 *   MOV (shifted) A7.7.78  lines 10545-10584
 *   MOVT          A7.7.79  lines 10585-10630
 *   ADR           A7.7.7   lines 6003-6110
 */

#include <zephyr/ztest.h>
#include <armv7m_test.h>

ZTEST(armv7m_alu_flags, test_mov_imm8)
{
	uint32_t r;

	__asm__ volatile("movs %[r], #0xAB\n\t" : [r] "=r"(r) : : "cc");
	zassert_equal(r, 0xABU, "MOV imm8 wrong: 0x%x", r);
}

ZTEST(armv7m_alu_flags, test_mov_imm16)
{
	uint32_t r;

	__asm__ volatile("movw %[r], #0x1234\n\t" : [r] "=r"(r) : : );
	zassert_equal(r, 0x1234U, "MOVW imm16 wrong");
}

ZTEST(armv7m_alu_flags, test_mov_imm_sets_n)
{
	uint32_t r, apsr;

	/* modified immediate: 0x80000000 */
	__asm__ volatile(
		"mov  %[r], #0x80000000\n\t"
		"movs %[r], %[r]\n\t"       /* MOVS to actually set flags */
		"mrs  %[f], apsr\n\t"
		: [r] "=&r"(r), [f] "=r"(apsr)
		:
		: "cc");
	zassert_equal(r, 0x80000000U, "MOV 0x80000000 wrong");
	zassert_true(armv7m_flag_n(apsr), "N not set");
}

ZTEST(armv7m_alu_flags, test_movt_upper_halfword)
{
	uint32_t r;

	__asm__ volatile(
		"movw %[r], #0x5678\n\t"
		"movt %[r], #0x1234\n\t"
		: [r] "=&r"(r)
		:
		: );
	zassert_equal(r, 0x12345678U, "MOVT upper halfword wrong: 0x%08x", r);
}

ZTEST(armv7m_alu_flags, test_movt_preserves_lower)
{
	uint32_t r;

	__asm__ volatile(
		"movw %[r], #0xBEEF\n\t"
		"movt %[r], #0xDEAD\n\t"
		: [r] "=&r"(r)
		:
		: );
	zassert_equal(r, 0xDEADBEEFU, "MOVT preserve lower wrong");
}

ZTEST(armv7m_alu_flags, test_movt_zero_upper)
{
	uint32_t r;

	__asm__ volatile(
		"movw %[r], #0xFFFF\n\t"
		"movt %[r], #0\n\t"
		: [r] "=&r"(r)
		:
		: );
	zassert_equal(r, 0x0000FFFFU, "MOVT zero upper wrong");
}

ZTEST(armv7m_alu_flags, test_mov_reg_copy)
{
	uint32_t src = 0xCAFEBABEU, dst;

	__asm__ volatile(
		"mov %[d], %[s]\n\t"
		: [d] "=r"(dst)
		: [s] "r"(src)
		: );
	zassert_equal(dst, src, "MOV reg copy wrong");
}

ZTEST(armv7m_alu_flags, test_movs_zero_sets_z)
{
	uint32_t r, apsr;

	__asm__ volatile(
		"movs %[r], #0\n\t"
		"mrs  %[f], apsr\n\t"
		: [r] "=&r"(r), [f] "=r"(apsr)
		:
		: "cc");
	zassert_equal(r, 0, "MOVS 0 wrong");
	zassert_true(armv7m_flag_z(apsr), "Z not set");
	zassert_false(armv7m_flag_n(apsr), "N spuriously set");
}

/* MOV with shifted register operand */
ZTEST(armv7m_alu_flags, test_mov_shifted_reg)
{
	uint32_t r;
	uint32_t src = 3U;

	__asm__ volatile(
		"mov %[r], %[s], lsl #2\n\t"
		: [r] "=r"(r)
		: [s] "r"(src)
		: );
	zassert_equal(r, 12, "MOV shifted reg wrong");
}

/* ADR: loads PC-relative address */
ZTEST(armv7m_alu_flags, test_adr_forward)
{
	uint32_t addr1, addr2;

	__asm__ volatile(
		"adr %[a], 1f\n\t"
		"nop\n\t"
		"nop\n\t"
		"1:\n\t"
		"adr %[b], 1b\n\t"
		: [a] "=r"(addr1), [b] "=r"(addr2)
		:
		: );
	/* addr1 should equal addr2 since they both point to label 1 */
	zassert_equal(addr1, addr2, "ADR forward/back mismatch: %x %x",
		      addr1, addr2);
}
```

## src/test_multiply.c
```c
/*
 * SPDX-License-Identifier: Apache-2.0
 * ARMv7-M ALU: Multiply and divide instructions.
 *
 * Reference: DDI0403E
 *   MUL    A7.7.84  lines 10831-10902
 *   MLA    A7.7.74  lines 10248-10303
 *   MLS    A7.7.75  lines 10304-10357
 *   SMULL  A7.7.149 lines 14624-14677
 *   UMULL  A7.7.204 lines 18047-18100
 *   SMLAL  A7.7.138 lines 13981-14034
 *   UMLAL  A7.7.203 lines 17993-18046
 *   SDIV   A7.7.127 lines 13389-13444
 *   UDIV   A7.7.195 lines 17573-17622
 */

#include <zephyr/ztest.h>
#include <armv7m_test.h>

/* MUL */
ZTEST(armv7m_alu_flags, test_mul_basic)
{
	uint32_t r;

	__asm__ volatile("mul %[r], %[a], %[b]\n\t"
			 : [r] "=r"(r)
			 : [a] "r"(6U), [b] "r"(7U)
			 : );
	zassert_equal(r, 42, "MUL 6x7 wrong");
}

ZTEST(armv7m_alu_flags, test_mul_zero)
{
	uint32_t r, apsr;

	/* Use mul then movs to check Z flag (MULS not available in Thumb-2 32-bit) */
	__asm__ volatile(
		"mul  %[r], %[a], %[b]\n\t"
		"movs %[r], %[r]\n\t"       /* MOVS to update Z */
		"mrs  %[f], apsr\n\t"
		: [r] "=&r"(r), [f] "=r"(apsr)
		: [a] "r"(0U), [b] "r"(0xFFFFFFFFU)
		: "cc");
	zassert_equal(r, 0, "MUL 0xFFFFFFFF*0 wrong");
	zassert_true(armv7m_flag_z(apsr), "Z not set");
}

ZTEST(armv7m_alu_flags, test_mul_wrap32)
{
	uint32_t r;

	/* 0x10000 * 0x10000 = 0x100000000 which truncates to 0 */
	__asm__ volatile("mul %[r], %[a], %[b]\n\t"
			 : [r] "=r"(r)
			 : [a] "r"(0x10000U), [b] "r"(0x10000U)
			 : );
	zassert_equal(r, 0, "MUL 64k*64k truncation wrong");
}

ZTEST(armv7m_alu_flags, test_mul_max_unsigned)
{
	uint32_t r;

	/* 0xFFFFFFFF * 0xFFFFFFFF low 32 = 0x00000001 */
	__asm__ volatile("mul %[r], %[a], %[b]\n\t"
			 : [r] "=r"(r)
			 : [a] "r"(0xFFFFFFFFU), [b] "r"(0xFFFFFFFFU)
			 : );
	zassert_equal(r, 1, "MUL 0xFFFFFFFF^2 low32 wrong: 0x%08x", r);
}

/* MLA: Rd = Ra + Rn*Rm */
ZTEST(armv7m_alu_flags, test_mla_accumulate)
{
	uint32_t r;

	__asm__ volatile("mla %[r], %[n], %[m], %[a]\n\t"
			 : [r] "=r"(r)
			 : [n] "r"(3U), [m] "r"(4U), [a] "r"(5U)
			 : );
	zassert_equal(r, 17, "MLA 5+3*4 wrong");
}

/* MLS: Rd = Ra - Rn*Rm */
ZTEST(armv7m_alu_flags, test_mls_subtract)
{
	uint32_t r;

	__asm__ volatile("mls %[r], %[n], %[m], %[a]\n\t"
			 : [r] "=r"(r)
			 : [n] "r"(3U), [m] "r"(4U), [a] "r"(100U)
			 : );
	zassert_equal(r, 88, "MLS 100-3*4 wrong");
}

/* UMULL: 64-bit unsigned */
ZTEST(armv7m_alu_flags, test_umull_basic)
{
	uint32_t hi, lo;

	__asm__ volatile("umull %[lo], %[hi], %[a], %[b]\n\t"
			 : [hi] "=r"(hi), [lo] "=r"(lo)
			 : [a] "r"(0x10000U), [b] "r"(0x10000U)
			 : );
	/* 0x10000 * 0x10000 = 0x100000000: hi=1, lo=0 */
	zassert_equal(hi, 1, "UMULL hi wrong");
	zassert_equal(lo, 0, "UMULL lo wrong");
}

ZTEST(armv7m_alu_flags, test_umull_max)
{
	uint32_t hi, lo;

	/* 0xFFFFFFFF * 0xFFFFFFFF = 0xFFFFFFFE00000001 */
	__asm__ volatile("umull %[lo], %[hi], %[a], %[b]\n\t"
			 : [hi] "=r"(hi), [lo] "=r"(lo)
			 : [a] "r"(0xFFFFFFFFU), [b] "r"(0xFFFFFFFFU)
			 : );
	zassert_equal(hi, 0xFFFFFFFEU, "UMULL max hi wrong: 0x%08x", hi);
	zassert_equal(lo, 0x00000001U, "UMULL max lo wrong: 0x%08x", lo);
}

/* SMULL: 64-bit signed */
ZTEST(armv7m_alu_flags, test_smull_negative)
{
	uint32_t hi, lo;

	/* -1 * -1 = 1 */
	__asm__ volatile("smull %[lo], %[hi], %[a], %[b]\n\t"
			 : [hi] "=r"(hi), [lo] "=r"(lo)
			 : [a] "r"(-1), [b] "r"(-1)
			 : );
	zassert_equal(hi, 0, "SMULL -1*-1 hi wrong");
	zassert_equal(lo, 1, "SMULL -1*-1 lo wrong");
}

ZTEST(armv7m_alu_flags, test_smull_signed_overflow)
{
	uint32_t hi, lo;

	/* 0x80000000 * 2 = 0xFFFFFFFF00000000 */
	__asm__ volatile("smull %[lo], %[hi], %[a], %[b]\n\t"
			 : [hi] "=r"(hi), [lo] "=r"(lo)
			 : [a] "r"(0x80000000U), [b] "r"(2U)
			 : );
	zassert_equal(hi, 0xFFFFFFFFU, "SMULL overflow hi wrong: 0x%08x", hi);
	zassert_equal(lo, 0, "SMULL overflow lo wrong");
}

/* UMLAL: lo:hi += a * b */
ZTEST(armv7m_alu_flags, test_umlal_accumulate)
{
	uint32_t hi = 0, lo = 5;

	__asm__ volatile("umlal %[lo], %[hi], %[a], %[b]\n\t"
			 : [hi] "+r"(hi), [lo] "+r"(lo)
			 : [a] "r"(3U), [b] "r"(4U)
			 : );
	/* 0 + 5 + 12 = 17 */
	zassert_equal(lo, 17, "UMLAL accumulate lo wrong");
	zassert_equal(hi, 0, "UMLAL accumulate hi wrong");
}

/* SMLAL */
ZTEST(armv7m_alu_flags, test_smlal_signed)
{
	uint32_t hi = 0xFFFFFFFFU, lo = 0xFFFFFFF0U;

	/* -16 + (-1 * 4) = -20 = 0xFFFFFFFFFFFFFFEC */
	__asm__ volatile("smlal %[lo], %[hi], %[a], %[b]\n\t"
			 : [hi] "+r"(hi), [lo] "+r"(lo)
			 : [a] "r"(-1), [b] "r"(4U)
			 : );
	zassert_equal(lo, 0xFFFFFFECU, "SMLAL lo wrong: 0x%08x", lo);
	zassert_equal(hi, 0xFFFFFFFFU, "SMLAL hi wrong: 0x%08x", hi);
}

/* SDIV */
ZTEST(armv7m_alu_flags, test_sdiv_positive)
{
	uint32_t r;

	__asm__ volatile("sdiv %[r], %[a], %[b]\n\t"
			 : [r] "=r"(r)
			 : [a] "r"(20), [b] "r"(3)
			 : );
	/* Truncates toward zero: 20/3 = 6 */
	zassert_equal(r, 6, "SDIV 20/3 wrong");
}

ZTEST(armv7m_alu_flags, test_sdiv_negative_truncate)
{
	uint32_t r;

	/* -7 / 2 = -3 (toward zero) */
	__asm__ volatile("sdiv %[r], %[a], %[b]\n\t"
			 : [r] "=r"(r)
			 : [a] "r"(-7), [b] "r"(2)
			 : );
	zassert_equal((int32_t)r, -3, "SDIV -7/2 wrong: %d", (int32_t)r);
}

ZTEST(armv7m_alu_flags, test_sdiv_exact)
{
	uint32_t r;

	__asm__ volatile("sdiv %[r], %[a], %[b]\n\t"
			 : [r] "=r"(r)
			 : [a] "r"(100), [b] "r"(5)
			 : );
	zassert_equal(r, 20, "SDIV 100/5 wrong");
}

/* UDIV */
ZTEST(armv7m_alu_flags, test_udiv_basic)
{
	uint32_t r;

	__asm__ volatile("udiv %[r], %[a], %[b]\n\t"
			 : [r] "=r"(r)
			 : [a] "r"(100U), [b] "r"(7U)
			 : );
	zassert_equal(r, 14, "UDIV 100/7 wrong");
}

ZTEST(armv7m_alu_flags, test_udiv_max)
{
	uint32_t r;

	__asm__ volatile("udiv %[r], %[a], %[b]\n\t"
			 : [r] "=r"(r)
			 : [a] "r"(0xFFFFFFFFU), [b] "r"(0xFFFFFFFFU)
			 : );
	zassert_equal(r, 1, "UDIV max/max wrong");
}
```

## src/test_saturate.c
```c
/*
 * SPDX-License-Identifier: Apache-2.0
 * ARMv7-M ALU: Saturating instructions (DSP extension).
 *
 * Reference: DDI0403E
 *   SSAT   A7.7.153
 *   USAT   A7.7.197
 *   QADD   A7.7.102 lines 11959-12012
 *   QSUB   A7.7.105
 *   QDADD  A7.7.103
 *   QDSUB  A7.7.104
 *
 * These instructions are part of the DSP extension (present on Cortex-M4/M4F,
 * ARMv7E-M).  Guard with CONFIG_CPU_HAS_DSP.
 *
 * SSAT: saturate to signed N-bit range.
 * USAT: saturate to unsigned N-bit range.
 * Q flag set on saturation (A2.3.2 line 788).
 */

#include <zephyr/ztest.h>
#include <armv7m_test.h>

#if defined(__ARM_FEATURE_DSP)

/* SSAT */
ZTEST(armv7m_alu_flags, test_ssat_within_range)
{
	uint32_t r, apsr;

	/* SSAT #8 saturates to [-128, 127]; value 50 is within range */
	__asm__ volatile(
		"ssat %[r], #8, %[v]\n\t"
		"mrs  %[f], apsr\n\t"
		: [r] "=r"(r), [f] "=r"(apsr)
		: [v] "r"(50)
		: "cc");
	zassert_equal((int32_t)r, 50, "SSAT in-range wrong");
	zassert_false(armv7m_flag_q(apsr), "Q spuriously set");
}

ZTEST(armv7m_alu_flags, test_ssat_clamp_positive)
{
	uint32_t r, apsr;

	/* SSAT #8: 200 > 127 => clamp to 127, Q set */
	__asm__ volatile(
		"mrs  %[f], apsr\n\t"  /* read current apsr */
		"bic  %[f], %[f], #0x08000000\n\t" /* clear Q */
		"msr  apsr_nzcvq, %[f]\n\t"
		"ssat %[r], #8, %[v]\n\t"
		"mrs  %[f], apsr\n\t"
		: [r] "=&r"(r), [f] "=&r"(apsr)
		: [v] "r"(200)
		: "cc");
	zassert_equal((int32_t)r, 127, "SSAT clamp positive wrong: %d",
		      (int32_t)r);
	zassert_true(armv7m_flag_q(apsr), "Q not set on saturation");
}

ZTEST(armv7m_alu_flags, test_ssat_clamp_negative)
{
	uint32_t r, apsr;

	/* SSAT #8: -200 < -128 => clamp to -128, Q set */
	__asm__ volatile(
		"mrs  %[f], apsr\n\t"
		"bic  %[f], %[f], #0x08000000\n\t"
		"msr  apsr_nzcvq, %[f]\n\t"
		"ssat %[r], #8, %[v]\n\t"
		"mrs  %[f], apsr\n\t"
		: [r] "=&r"(r), [f] "=&r"(apsr)
		: [v] "r"(-200)
		: "cc");
	zassert_equal((int32_t)r, -128, "SSAT clamp negative wrong: %d",
		      (int32_t)r);
	zassert_true(armv7m_flag_q(apsr), "Q not set");
}

/* USAT */
ZTEST(armv7m_alu_flags, test_usat_within_range)
{
	uint32_t r, apsr;

	/* USAT #8: 200 is within [0, 255] */
	__asm__ volatile(
		"usat %[r], #8, %[v]\n\t"
		"mrs  %[f], apsr\n\t"
		: [r] "=r"(r), [f] "=r"(apsr)
		: [v] "r"(200)
		: "cc");
	zassert_equal(r, 200, "USAT in-range wrong");
	zassert_false(armv7m_flag_q(apsr), "Q spuriously set");
}

ZTEST(armv7m_alu_flags, test_usat_clamp_positive)
{
	uint32_t r, apsr;

	/* USAT #8: 300 > 255 => clamp to 255, Q set */
	__asm__ volatile(
		"mrs  %[f], apsr\n\t"
		"bic  %[f], %[f], #0x08000000\n\t"
		"msr  apsr_nzcvq, %[f]\n\t"
		"usat %[r], #8, %[v]\n\t"
		"mrs  %[f], apsr\n\t"
		: [r] "=&r"(r), [f] "=&r"(apsr)
		: [v] "r"(300)
		: "cc");
	zassert_equal(r, 255, "USAT clamp positive wrong: %d", r);
	zassert_true(armv7m_flag_q(apsr), "Q not set");
}

ZTEST(armv7m_alu_flags, test_usat_clamp_negative)
{
	uint32_t r, apsr;

	/* USAT #8: -1 < 0 => clamp to 0, Q set */
	__asm__ volatile(
		"mrs  %[f], apsr\n\t"
		"bic  %[f], %[f], #0x08000000\n\t"
		"msr  apsr_nzcvq, %[f]\n\t"
		"usat %[r], #8, %[v]\n\t"
		"mrs  %[f], apsr\n\t"
		: [r] "=&r"(r), [f] "=&r"(apsr)
		: [v] "r"(-1)
		: "cc");
	zassert_equal(r, 0, "USAT clamp negative wrong");
	zassert_true(armv7m_flag_q(apsr), "Q not set");
}

/* QADD: saturating signed add */
ZTEST(armv7m_alu_flags, test_qadd_no_sat)
{
	uint32_t r, apsr;

	__asm__ volatile(
		"mrs  %[f], apsr\n\t"
		"bic  %[f], %[f], #0x08000000\n\t"
		"msr  apsr_nzcvq, %[f]\n\t"
		"qadd %[r], %[a], %[b]\n\t"
		"mrs  %[f], apsr\n\t"
		: [r] "=&r"(r), [f] "=&r"(apsr)
		: [a] "r"(100), [b] "r"(200)
		: "cc");
	zassert_equal((int32_t)r, 300, "QADD no-sat wrong");
	zassert_false(armv7m_flag_q(apsr), "Q spuriously set");
}

ZTEST(armv7m_alu_flags, test_qadd_sat_positive)
{
	uint32_t r, apsr;

	/* 0x7FFFFFFF + 1 saturates to 0x7FFFFFFF */
	__asm__ volatile(
		"mrs  %[f], apsr\n\t"
		"bic  %[f], %[f], #0x08000000\n\t"
		"msr  apsr_nzcvq, %[f]\n\t"
		"qadd %[r], %[a], %[b]\n\t"
		"mrs  %[f], apsr\n\t"
		: [r] "=&r"(r), [f] "=&r"(apsr)
		: [a] "r"(0x7FFFFFFFU), [b] "r"(1)
		: "cc");
	zassert_equal((int32_t)r, 0x7FFFFFFF, "QADD sat positive wrong");
	zassert_true(armv7m_flag_q(apsr), "Q not set");
}

#else
ZTEST(armv7m_alu_flags, test_ssat_within_range)   { ztest_test_skip(); }
ZTEST(armv7m_alu_flags, test_ssat_clamp_positive) { ztest_test_skip(); }
ZTEST(armv7m_alu_flags, test_ssat_clamp_negative) { ztest_test_skip(); }
ZTEST(armv7m_alu_flags, test_usat_within_range)   { ztest_test_skip(); }
ZTEST(armv7m_alu_flags, test_usat_clamp_positive) { ztest_test_skip(); }
ZTEST(armv7m_alu_flags, test_usat_clamp_negative) { ztest_test_skip(); }
ZTEST(armv7m_alu_flags, test_qadd_no_sat)         { ztest_test_skip(); }
ZTEST(armv7m_alu_flags, test_qadd_sat_positive)   { ztest_test_skip(); }
#endif
```
