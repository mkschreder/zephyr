## boards/arm/vemu_cortex_m55_npu/Kconfig.defconfig
```kconfig
# Copyright (c) 2026 Martin Schröder <info@swedishembedded.com>
# SPDX-License-Identifier: Apache-2.0

if BOARD_VEMU_CORTEX_M55_NPU

config BUILD_OUTPUT_BIN
	default n

choice NULL_POINTER_EXCEPTION_DETECTION
	bool
	default NULL_POINTER_EXCEPTION_DETECTION_NONE
endchoice

endif # BOARD_VEMU_CORTEX_M55_NPU
```

## boards/arm/vemu_cortex_m55_npu/Kconfig.vemu_cortex_m55_npu
```kconfig
# Copyright (c) 2026 Martin Schröder <info@swedishembedded.com>
# SPDX-License-Identifier: Apache-2.0

config BOARD_VEMU_CORTEX_M55_NPU
	select SOC_VEMU_CORTEX_M33
```

## boards/arm/vemu_cortex_m55_npu/board.yml
```yaml
board:
  name: vemu_cortex_m55_npu
  full_name: VEMU Cortex-M55 with Arm Ethos-U65 NPU
  vendor: arm
  socs:
  - name: vemu_cortex_m33
```

## boards/arm/vemu_cortex_m55_npu/vemu_cortex_m55_npu_defconfig
```kconfig
# Copyright (c) 2026 Martin Schröder <info@swedishembedded.com>
# SPDX-License-Identifier: Apache-2.0

CONFIG_SYS_CLOCK_HW_CYCLES_PER_SEC=12000000
CONFIG_CONSOLE=y
CONFIG_UART_CONSOLE=y
CONFIG_SERIAL=y
CONFIG_UART_PL011=y
CONFIG_SCHED_MULTIQ=y
CONFIG_ARM_MPU=y
CONFIG_QEMU_ICOUNT_SHIFT=6
CONFIG_FLASH_SIZE=512
CONFIG_SRAM_SIZE=128

# Ethos-U65-256 NPU
CONFIG_ETHOS_U=y
CONFIG_ETHOS_U65_256=y
```

## boards/luckfox/luckfox_pico_plus/Kconfig.luckfox_pico_plus
```kconfig
# Copyright (c) 2026 Martin Schröder <info@swedishembedded.com>
# SPDX-License-Identifier: Apache-2.0

config BOARD_LUCKFOX_PICO_PLUS
	select SOC_RV1106
```

## boards/luckfox/luckfox_pico_plus/board.yml
```yaml
board:
  name: luckfox_pico_plus
  full_name: Luckfox Pico Plus
  vendor: luckfox
  socs:
  - name: rv1106
```

## boards/luckfox/luckfox_pico_plus/luckfox_pico_plus_defconfig
```kconfig
# Copyright (c) 2026 Martin Schröder <info@swedishembedded.com>
# SPDX-License-Identifier: Apache-2.0

# Serial driver
CONFIG_SERIAL=y

# Console over UART
CONFIG_CONSOLE=y
CONFIG_UART_CONSOLE=y
```

## boards/qemu/cortex_m33/Kconfig.defconfig
```kconfig
# Copyright (c) 2026 Martin Schröder <info@swedishembedded.com>
# SPDX-License-Identifier: Apache-2.0

if BOARD_QEMU_CORTEX_M33

config BUILD_OUTPUT_BIN
	default n

choice NULL_POINTER_EXCEPTION_DETECTION
	bool
	default NULL_POINTER_EXCEPTION_DETECTION_NONE
endchoice

endif # BOARD_QEMU_CORTEX_M33
```

## boards/qemu/cortex_m33/Kconfig.qemu_cortex_m33
```kconfig
# Copyright (c) 2026 Martin Schröder <info@swedishembedded.com>
# SPDX-License-Identifier: Apache-2.0

config BOARD_QEMU_CORTEX_M33
	select SOC_VEMU_CORTEX_M33
```

## boards/qemu/cortex_m33/board.yml
```yaml
board:
  name: qemu_cortex_m33
  full_name: QEMU Emulation for ARM Cortex-M33 (vemu compatible)
  vendor: arm
  socs:
  - name: vemu_cortex_m33
```

## boards/qemu/cortex_m33/qemu_cortex_m33_defconfig
```kconfig
# Copyright (c) 2026 Martin Schröder <info@swedishembedded.com>
# SPDX-License-Identifier: Apache-2.0

CONFIG_SYS_CLOCK_HW_CYCLES_PER_SEC=12000000
CONFIG_CONSOLE=y
CONFIG_UART_CONSOLE=y
CONFIG_SERIAL=y
CONFIG_UART_PL011=y
CONFIG_SCHED_MULTIQ=y
CONFIG_ARM_TRUSTZONE_M=y
CONFIG_ARM_MPU=y
CONFIG_TRUSTED_EXECUTION_SECURE=y
CONFIG_QEMU_ICOUNT_SHIFT=6
CONFIG_FLASH_SIZE=512
CONFIG_SRAM_SIZE=128
```

## drivers/flash/Kconfig.mmio_nor
```kconfig
# Copyright (c) 2026 Martin Schröder <info@swedishembedded.com>
# SPDX-License-Identifier: Apache-2.0

config FLASH_MMIO_NOR
	bool "Memory-mapped NOR flash (read-only, vemu)"
	default y
	depends on DT_HAS_VEMU_MMIO_FLASH_ENABLED
	select FLASH_HAS_DRIVER_ENABLED
	help
	  Minimal read-only driver for memory-mapped NOR flash on vemu boards.
	  The flash region is file-backed and mapped directly to the CPU address
	  space by vemu. Provides read access for MCUboot and Zephyr flash-map
	  APIs. Write and erase operations are not supported (-ENOTSUP).
```

## dts/bindings/arm/arm,armv8m-sau-region.yaml
```yaml
# Copyright 2026 Martin Schröder <info@swedishembedded.com>
# SPDX-License-Identifier: Apache-2.0

description: |
  ARMv8-M Security Attribution Unit (SAU) region.

  Each enabled child of an arm,armv8m-sau node describes one SAU region.
  Regions are programmed in ascending numerical order (reg index) at boot.

  Reference: ARM DDI 0553 §B3.4 (SAU programmer's model).

compatible: "arm,armv8m-sau-region"

include: base.yaml

properties:
  reg:
    required: true
    description: |
      Two-cell specifier: <base-address size>.
      base-address must be 32-byte aligned (DDI 0553 §B3.4.4 RBAR.BADDR).
      (base-address + size - 1) gives the last byte; the SAU RLAR stores
      bits [31:5] of that address, so size must be a multiple of 32 bytes.

  nsc:
    type: boolean
    description: |
      When present, mark the region as Non-Secure Callable (NSC).
      NSC regions contain SG veneers and must be mapped in the SAU with
      RLAR.NSC=1. DDI 0553 §B3.4.5.
```

## dts/bindings/arm/arm,armv8m-sau.yaml
```yaml
# Copyright 2026 Martin Schröder <info@swedishembedded.com>
# SPDX-License-Identifier: Apache-2.0

description: |
  ARMv8-M Security Attribution Unit (SAU) controller.

  Declare the SAU and its regions in the device tree so that Zephyr can
  program security attribution automatically at boot without ad-hoc C code.

  Example (Cortex-M33, two regions):

    sau: sau@e000edd0 {
        compatible = "arm,armv8m-sau";
        reg = <0xe000edd0 0x14>;

        /* 0x00000000-0x0fffffff: Non-Secure flash */
        region0: region@0 {
            compatible = "arm,armv8m-sau-region";
            reg = <0x00000000 0x10000000>;
        };

        /* 0x0ffe0000-0x0fffffff: Non-Secure Callable veneer window */
        region1: region@1 {
            compatible = "arm,armv8m-sau-region";
            reg = <0x0ffe0000 0x20000>;
            nsc;
        };
    };

  Reference: ARM DDI 0553 §B3.4.

compatible: "arm,armv8m-sau"

include: base.yaml

properties:
  reg:
    required: true

  "#address-cells":
    type: int
    const: 1
    description: Number of address cells for child region nodes.

  "#size-cells":
    type: int
    const: 1
    description: Number of size cells for child region nodes.
```

## dts/bindings/arm/arm,trustzone-cross-core.yaml
```yaml
# Copyright 2026 Martin Schröder <info@swedishembedded.com>
# SPDX-License-Identifier: Apache-2.0

description: |
  ARM TrustZone cross-core security coordination binding.

  Used on dual-core SoCs where one core runs the Secure world and another
  runs the Non-Secure world, and where a hardware mechanism (mailbox, shared
  memory, or vendor security controller) must coordinate security state
  across the core boundary.

  Examples:
    - Nordic nRF5340 (Application Core = NS, Network Core = Secure)
    - STM32H745 / STM32H755 (Cortex-M7 S + Cortex-M4 NS)

  Child nodes describe the communication/coordination resource:
    - shared-memory regions visible to both cores
    - mailbox channels used for security notifications

  Reference: ARM DDI 0553B §A1.3.2 (multi-core TrustZone).

compatible: "arm,trustzone-cross-core"

properties:
  secure-core:
    type: phandle
    required: true
    description: |
      Phandle to the CPU node that runs the Secure firmware.

  nonsecure-core:
    type: phandle
    required: true
    description: |
      Phandle to the CPU node that runs the Non-Secure firmware.

  shared-memory:
    type: phandle
    required: false
    description: |
      Phandle to a shared memory region (e.g. a fixed-partition node) used
      for cross-core security state communication.

  mailbox:
    type: phandle
    required: false
    description: |
      Phandle to a mailbox / IPC node used to signal security events
      (e.g. NS firmware reset notification) across cores.

  label:
    type: string
    required: false
    description: Human-readable identifier for this cross-core coordinator.
```

## dts/bindings/mtd/vemu,mmio-flash.yaml
```yaml
description: |
  Memory-mapped NOR flash for vemu simulation boards.
  The flash region is file-backed and mapped directly to the physical address
  space by vemu. Provides read-only access; write and erase are not supported.

compatible: "vemu,mmio-flash"

include: [base.yaml, flash-controller.yaml]

properties:
  reg:
    required: true

  erase-block-size:
    type: int
    default: 4096
    description: |
      Erase block granularity in bytes (informational; erases not supported).

  write-block-size:
    type: int
    default: 4
    description: |
      Minimum write granularity in bytes (informational; writes not supported).

  max-erase-time:
    type: int
    description: |
      Maximum erase time in milliseconds (informational; from st,stm32-nv-flash; ignored by vemu).

  bank2-flash-size:
    type: int
    description: |
      Flash bank 2 size in KBytes (informational; from st,stm32-nv-flash; ignored by vemu).
```

## soc/arm/vemu_cortex_m33/Kconfig
```kconfig
# Copyright (c) 2026 Martin Schröder <info@swedishembedded.com>
# SPDX-License-Identifier: Apache-2.0

config SOC_VEMU_CORTEX_M33
	select ARM
	select CPU_CORTEX_M33
	select CPU_HAS_ARM_SAU
	select CPU_HAS_ARM_MPU
```

## soc/arm/vemu_cortex_m33/Kconfig.defconfig
```kconfig
# Copyright (c) 2026 Martin Schröder <info@swedishembedded.com>
# SPDX-License-Identifier: Apache-2.0

if SOC_VEMU_CORTEX_M33

config SOC_SERIES
	default "vemu_cortex_m33"

config NUM_IRQS
	default 64

config SYS_CLOCK_HW_CYCLES_PER_SEC
	default 12000000

endif # SOC_VEMU_CORTEX_M33
```

## soc/arm/vemu_cortex_m33/Kconfig.soc
```kconfig
# Copyright (c) 2026 Martin Schröder <info@swedishembedded.com>
# SPDX-License-Identifier: Apache-2.0

config SOC_VEMU_CORTEX_M33
	bool
	select SOC_FAMILY_ARM
	help
	  vemu virtual Cortex-M33 SoC (LM3S-compatible peripherals, ARMv8-M Mainline core).

config SOC
	default "vemu_cortex_m33" if SOC_VEMU_CORTEX_M33
```

## soc/rockchip/rv1106/Kconfig
```kconfig
# Copyright (c) 2026 Martin Schröder <info@swedishembedded.com>
# SPDX-License-Identifier: Apache-2.0

config SOC_RV1106
	select ARM
	select CPU_CORTEX_A7
	select ARM_ARCH_TIMER
	select ARM_AARCH32_MMU
	select CACHE_MANAGEMENT
	select SYS_CLOCK_EXISTS

config SOC_PART_NUMBER
	default "RV1106" if SOC_SERIES_RV1106
```

## soc/rockchip/rv1106/Kconfig.defconfig
```kconfig
# Copyright (c) 2026 Martin Schröder <info@swedishembedded.com>
# SPDX-License-Identifier: Apache-2.0

if SOC_SERIES_RV1106

config NUM_IRQS
	default 256

config SYS_CLOCK_HW_CYCLES_PER_SEC
	default $(dt_node_int_prop_int,/cpus/cpu@0,clock-frequency)

if SERIAL

config UART_NS16550
	default y

config UART_NS16550_DW8250_DW_APB
	default y

config UART_NS16550_ACCESS_WORD_ONLY
	default y

endif # SERIAL

endif # SOC_SERIES_RV1106
```

## tests/arch/arm/arm_trustzone/testcase.yaml
```yaml
tests:
  arm_trustzone:
    tags: arm trustzone
    platform_allow:
      - mps2_an521/mps2/cpu0/ns
      - mps2_an521/mps2/cpu0
      - qemu_cortex_m33
    integration_platforms:
      - qemu_cortex_m33
    harness: ztest
    timeout: 90
    extra_configs:
      - CONFIG_ARM_TRUSTZONE_M=y
      - CONFIG_TRUSTED_EXECUTION_SECURE=y
      - CONFIG_EXTRA_EXCEPTION_INFO=y
```

## tests/arch/arm/arm_trustzone_fault_injection/testcase.yaml
```yaml
tests:
  arch.arm.trustzone.fault_injection:
    tags:
      - arm
      - trustzone
    filter: CONFIG_ARM_SECURE_FIRMWARE
    platform_allow:
      - mps2/an521/cpu0/secure
      - lpcxpresso55s69/lpc55s69/cpu0/secure
    timeout: 60
    harness: ztest
    harness_config:
      type: one_line
      regex:
        - "PROJECT EXECUTION SUCCESSFUL"
```

## tests/arch/arm/armv7m/alu_flags/testcase.yaml
```yaml
common:
  filter: CONFIG_ARMV7_M_ARMV8_M_MAINLINE
  tags:
    - arm
    - armv7m
    - torture
  arch_allow: arm
  platform_allow:
    - qemu_cortex_m3
    - mps2_an385
tests:
  arch.arm.armv7m.alu_flags:
    filter: not CONFIG_TRUSTED_EXECUTION_NONSECURE
  arch.arm.armv7m.alu_flags.no_optimizations:
    filter: not CONFIG_TRUSTED_EXECUTION_NONSECURE
    extra_configs:
      - CONFIG_NO_OPTIMIZATIONS=y
      - CONFIG_ZTEST_WARN_NO_OPTIMIZATIONS=n
    min_flash: 256
```
